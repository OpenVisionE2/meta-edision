## conf/machine/include/edision-4k.inc
```bitbake
KERNELVERSION = "5.9"

SOC_FAMILY = "bcm72604"

BOX_BRAND = "edision"

# We know about rtc
MACHINE_FEATURES_BACKFILL_CONSIDERED += "rtc"

DEFAULTTUNE = "armv7vehf-neon-vfpv4"
KERNEL_IMAGETYPE = "zImage"

require conf/machine/include/arm/arch-armv8a.inc

MACHINE_ESSENTIAL_EXTRA_RDEPENDS += "\
	edision-dvb-modules-${MACHINE} \
	edision-resizerootfs \
	edision-splash \
	${@bb.utils.contains('MACHINE_FEATURES', 'swap', 'edision-swapcreate', '',d)} \
	firmware-avl62x1-edision \
	firmware-avl68x2-edision \
	firmware-dvb-demod-si2168-a20 \
	firmware-dvb-demod-si2168-a30 \
	firmware-dvb-demod-si2168-b40 \
	firmware-dvb-tuner-si2158-a20 \
	firmware-qca6174 \
	kernel-module-dvb-usb-dvbsky \
	kernel-module-dvb-usb-v2 \
	kernel-module-extrawlan-qca6174 \
	kernel-module-m88ds3103 \
	kernel-module-rt2800usb \
	kernel-module-si2157 \
	kernel-module-si2168 \
	wireless-regdb-static \
	"

DVBMEDIASINK_CONFIG = "--with-wma --with-pcm --with-dtsdownmix --with-eac3 --with-h265 --with-vb9"

PREFERRED_PROVIDER_virtual/blindscan-dvbs = "edision-blindscan-utils-${MACHINE}"
PREFERRED_PROVIDER_virtual/blindscan-dvbc = "edision-blindscan-utils-${MACHINE}"

PREFERRED_PROVIDER_virtual/kernel = "linux-edision"
PREFERRED_VERSION_linux-edision = "${KERNELVERSION}"

MTD_BOOTFS = "mmcblk1p1"
MTD_BLACK  = "mmcblk1"
MTD_KERNEL = "mmcblk1p2"
MTD_ROOTFS = "mmcblk1p3"
KERNEL_FILE = "kernel.bin"
ROOTFS_FILE = "rootfs.tar.bz2"

KERNEL_CONSOLE = "ttyS0,115200n8"

MACHINE_FEATURES += "alsa switchoff hdmicec osdposition dvb-c blindscan-tbs blindscan-dvbs blindscan-dvbc satip mountboot videoenhancement mmc emmc swap HDMI"

require conf/machine/include/rootfs-emmc.inc

STB_PLATFORM = "edision4k"

RCNAME = "edision3"
```

## conf/machine/include/edision-mipsel.inc
```bitbake
TARGET_ARCH = "mipsel"
DEFAULTTUNE = "mips32el"

require conf/machine/include/tune-mips32.inc

# We know about rtc
MACHINE_FEATURES_BACKFILL_CONSIDERED += "rtc"

BOX_BRAND = "edision"

MACHINE_ESSENTIAL_EXTRA_RDEPENDS += "\
	edision-splash \
	firmware-dvb-demod-si2168-a20 \
	firmware-dvb-demod-si2168-a30 \
	firmware-dvb-demod-si2168-b40 \
	firmware-dvb-tuner-si2158-a20 \
	kernel-module-dvb-usb-dvbsky \
	kernel-module-dvb-usb-v2 \
	kernel-module-extrawlan-rt8723bs \
	kernel-module-hci-uart \
	kernel-module-m88ds3103 \
	kernel-module-si2157 \
	kernel-module-si2168 \
	os-dvb-modules-${MACHINE} \
	"

DVBMEDIASINK_CONFIG = "--with-wma --with-wmv --with-pcm --with-dts --with-eac3"

PREFERRED_PROVIDER_virtual/kernel = "linux-os"

KERNEL_IMAGETYPE = "vmlinux.gz"
KERNEL_CONSOLE = "ttyS0,115200n8"

KERNEL_MODULE_AUTOLOAD += "\
	r8723bs \
	hci_uart \
	"

MACHINE_FEATURES += "alsa switchoff osdposition hdmicec dvb-c videoenhancement HDMI linuxwifi"

require conf/machine/include/rootfs-ubi.inc

KERNEL_FILE = "kernel.bin"
ROOTFS_FILE = "rootfs.bin"

STB_PLATFORM = "edisionmips"
```

## conf/machine/include/rootfs-emmc.inc
```bitbake
IMAGE_CLASSES += "edision4k-emmcimg"
IMAGE_FSTYPES ?= "emmcimg tar.bz2"
IMAGE_OVERHEAD_FACTOR = "1.0"

IMAGEDIR ?= "${MACHINE}"
IMGDEPLOYDIR ?= "${DEPLOY_DIR_IMAGE}"

IMAGE_CMD_emmcimg_append = "\
    mkdir -p ${IMGDEPLOYDIR}/${IMAGEDIR}; \
    cp -f ${IMGDEPLOYDIR}/${IMAGE_NAME}${IMAGE_NAME_SUFFIX}.emmc ${IMGDEPLOYDIR}/${IMAGEDIR}/emmc.img; \
    cp -f ${DEPLOY_DIR_IMAGE}/${KERNEL_IMAGETYPE}-${MACHINE}.bin ${IMGDEPLOYDIR}/${IMAGEDIR}/kernel.bin; \
    cp -f ${IMGDEPLOYDIR}/${IMAGE_NAME}${IMAGE_NAME_SUFFIX}.tar.bz2 ${IMGDEPLOYDIR}/${IMAGEDIR}/rootfs.tar.bz2; \
    cp -f ${DEPLOY_DIR_IMAGE}/splash.bin ${IMGDEPLOYDIR}/${IMAGEDIR}; \
    echo "${IMAGE_NAME}" > ${IMGDEPLOYDIR}/${IMAGEDIR}/imageversion; \
    echo "rename this file to 'force' to force an update without confirmation" > ${IMGDEPLOYDIR}/${IMAGEDIR}/noforce; \
    echo "***** ATTENTION *****" >${IMGDEPLOYDIR}/${IMAGEDIR}/recovery_${MACHINE}_READ.ME; \
    echo "The RECOVERY is only required for new installation of the ${MACHINE}" >>${IMGDEPLOYDIR}/${IMAGEDIR}/recovery_${MACHINE}_READ.ME; \
    echo "The ${IMAGE_NAME}_recovery_emmc.zip deletes all images including the multiboot images" >>${IMGDEPLOYDIR}/${IMAGEDIR}/recovery_${MACHINE}_READ.ME; \
    rm -f ${IMGDEPLOYDIR}/*.zip; \
    cd ${IMGDEPLOYDIR}; \
    zip -j ${IMAGE_NAME}_recovery_emmc.zip ${IMAGEDIR}/emmc.img ${IMAGEDIR}/imageversion ${IMAGEDIR}/recovery_${MACHINE}_READ.ME ${IMAGEDIR}/noforce ${IMAGEDIR}/splash.bin ; \
    zip -j ${IMAGE_NAME}_usb.zip ${IMAGEDIR}/imageversion ${IMAGEDIR}/kernel.bin ${IMAGEDIR}/rootfs.tar.bz2; \
    rm -rf ${IMAGEDIR}; \
    "
```

## conf/machine/osmega.conf
```bitbake
#@TYPE: Machine
#@NAME: Edision OS mega
#@DESCRIPTION: Machine configuration for the Edision OS mega

CHIPSET = "bcm73565"

require conf/machine/include/edision-mipsel.inc

MACHINE_ESSENTIAL_EXTRA_RRECOMMENDS += "kernel-module-cdfs"

DVBMEDIASINK_CONFIG += "--with-h265"

PREFERRED_PROVIDER_virtual/blindscan-dvbs = "os-blindscan-utils"
PREFERRED_PROVIDER_virtual/blindscan-dvbc = "os-blindscan-utils"

PREFERRED_VERSION_linux-os = "4.11"

PREFERRED_PROVIDER_virtual/egl = "v3d-libgles-${MACHINE}"
PREFERRED_PROVIDER_virtual/libgles2 = "v3d-libgles-${MACHINE}"

MTD_KERNEL = "mtd0"

MACHINE_FEATURES += "blindscan-dvbs blindscan-dvbc ci"
```

## conf/machine/osmini.conf
```bitbake
#@TYPE: Machine
#@NAME: Edision OS mini
#@DESCRIPTION: Machine configuration for the Edision OS mini

CHIPSET = "bcm7362"

require conf/machine/include/edision-mipsel.inc

PREFERRED_PROVIDER_virtual/blindscan-dvbs = "os-blindscan-utils"
PREFERRED_PROVIDER_virtual/blindscan-dvbc = "os-blindscan-utils"

PREFERRED_VERSION_linux-os = "4.11"

MTD_KERNEL = "mtd0"
MTD_ROOTFS = "mtd2"

MACHINE_FEATURES += "7segment blindscan-dvbs blindscan-dvbc tuxtxtclearscreen"
```

## conf/machine/osminiplus.conf
```bitbake
#@TYPE: Machine
#@NAME: Edision OS mini+
#@DESCRIPTION: Machine configuration for the Edision OS mini+

CHIPSET = "bcm73625"

require conf/machine/include/edision-mipsel.inc

MACHINE_ESSENTIAL_EXTRA_RRECOMMENDS += "kernel-module-cdfs"

DVBMEDIASINK_CONFIG += "--with-h265"

PREFERRED_PROVIDER_virtual/blindscan-dvbs = "os-blindscan-utils"
PREFERRED_PROVIDER_virtual/blindscan-dvbc = "os-blindscan-utils"

PREFERRED_VERSION_linux-os = "4.11"

MTD_KERNEL = "mtd0"

MACHINE_FEATURES += "blindscan-dvbs blindscan-dvbc tuxtxtclearscreen"
```

## conf/machine/osmio4k.conf
```bitbake
#@TYPE: Machine
#@NAME: Edision OS mio 4k
#@DESCRIPTION: Machine configuration for the Edision OS mio 4k

require conf/machine/include/edision-4k.conf

MACHINE_FEATURES += "alsa 3dtv switchoff osdposition hdmicec textlcd 7segment"
```

## conf/machine/osmio4kplus.conf
```bitbake
#@TYPE: Machine
#@NAME: Edision OS mio 4K plus
#@DESCRIPTION: Machine configuration for the Edision OS mio 4K plus

require conf/machine/include/edision-4k.inc

MACHINE_FEATURES += "bwlcd128 inibt wifi-direct"

MACHINE_ESSENTIAL_EXTRA_RRECOMMENDS += "\
	kernel-module-hci-uart \
	kernel-module-btqca \
	"

KERNEL_MODULE_AUTOLOAD += "\
	wlan \
	hci_uart \
	"
```

## conf/machine/osnino.conf
```bitbake
#@TYPE: Machine
#@NAME: Edision OS nino
#@DESCRIPTION: Machine configuration for the Edision OS nino

KERNELVERSION = "4.8.17"

SOC_FAMILY = "bcm7362"

require conf/machine/include/edision-mipsel.inc

PREFERRED_VERSION_linux-os = "${KERNELVERSION}"

MTD_KERNEL = "mtd2"
MTD_ROOTFS = "mtd0"

MACHINE_FEATURES += "textlcd 7segment vfdsymbol"

RCNAME = "edision1"

KERNEL_MODULE_AUTOLOAD += "8723ds"

MACHINE_ESSENTIAL_EXTRA_RDEPENDS += "\
	firmware-8723bs \
	firmware-8723ds \
	rtk-hciattach \
	kernel-module-extrawlan-rt8723ds \
	"
```

## conf/machine/osninoplus.conf
```bitbake
#@TYPE: Machine
#@NAME: Edision OS nino+
#@DESCRIPTION: Machine configuration for the Edision OS nino+

KERNELVERSION = "4.8.17"

SOC_FAMILY = "bcm73625"

require conf/machine/include/edision-mipsel.inc

DVBMEDIASINK_CONFIG += "--with-h265"

#PREFERRED_PROVIDER_virtual/blindscan-dvbs = "os-blindscan-utils"
#PREFERRED_PROVIDER_virtual/blindscan-dvbc = "os-blindscan-utils"

PREFERRED_VERSION_linux-os = "${KERNELVERSION}"

MTD_KERNEL = "mtd2"
MTD_ROOTFS = "mtd0"

MACHINE_FEATURES += "textlcd 7segment vfdsymbol"

RCNAME = "edision2"

KERNEL_MODULE_AUTOLOAD += "8723ds"

MACHINE_ESSENTIAL_EXTRA_RDEPENDS += "\
	firmware-8723bs \
	firmware-8723ds \
	rtk-hciattach \
	kernel-module-extrawlan-rt8723ds \
	"
```

## conf/machine/osninopro.conf
```bitbake
#@TYPE: Machine
#@NAME: Edision OS nino pro
#@DESCRIPTION: Machine configuration for the Edision OS nino pro

CHIPSET = "bcm73625"

require conf/machine/include/edision-mipsel.inc

MACHINE_ESSENTIAL_EXTRA_RRECOMMENDS += "kernel-module-cdfs"

DVBMEDIASINK_CONFIG += "--with-h265"

PREFERRED_PROVIDER_virtual/blindscan-dvbs = "edision-blindscan-utils-${MACHINE}"
PREFERRED_PROVIDER_virtual/blindscan-dvbc = "edision-blindscan-utils-${MACHINE}"

PREFERRED_VERSION_linux-os = "4.8.17"

MTD_KERNEL = "mtd2"

MACHINE_FEATURES += "7segment blindscan-dvbs blindscan-dvbc"
```
